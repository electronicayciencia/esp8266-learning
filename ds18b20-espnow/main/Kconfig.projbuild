## ds18b20-espnow/main/Kconfig.projbuild
```kconfig
menu "ESPNOW Thermometer Configuration"
      
config ESPNOW_CHANNEL
    int "Channel"
    default 1
    range 1 13
    help
        The channel on which sending and receiving ESPNOW data.

config MEASUREMENT_INTERVAL
    int "Measurement interval"
    default 1
    range 0 65535
    help
        Time between measures in seconds. 0: continuosly.

endmenu
```

## espnow-rx/main/Kconfig.projbuild
```kconfig
menu "ESPNOW RX Configuration"
      
config ESPNOW_CHANNEL
    int "Channel"
    default 1
    range 1 13
    help
        The channel on which sending and receiving ESPNOW data.

choice ESPNOW_OUTPUT_FORMAT
    prompt "Output format"
    default READABLE
    help
        Output format pretty or ugly.
    
config ESPNOW_OUTPUT_READABLE
    bool "Readable"
config ESPNOW_OUTPUT_SCRIPTABLE
    bool "Scriptable"
endchoice

config ESPNOW_QUEUE_SIZE
    int "Size"
    default 10
    range 1 50
    help
        Max size of incoming queue.

endmenu
```

## espnow-tx/main/Kconfig.projbuild
```kconfig
menu "ESPNOW Configuration"
      
config ESPNOW_CHANNEL
    int "Channel"
    default 1
    range 1 13
    help
        The channel on which sending and receiving ESPNOW data.

config ESPNOW_INTERVAL_MS
    int "Send interval"
    default 1000
    range 0 65535
    help
        Delay between sending two ESPNOW data, unit: ms.

endmenu
```
